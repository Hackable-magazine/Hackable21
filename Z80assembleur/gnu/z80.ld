/* OUTPUT_FORMAT("binary") */
OUTPUT_FORMAT("coff-z80")
OUTPUT_ARCH("z80")
SECTIONS
{
.text :	{
	*(.text)
	*(text)
	 __Htext = .;
	}
.data :	{
	 __Ldata = .;
	*(.data)
	*(data)
	 __Hdata = .;
	}
.bss :	{
	 __Lbss = .;
	*(.bss)
	*(bss)
	 __Hbss = .;
	}
}
